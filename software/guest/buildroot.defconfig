## software/guest/buildroot.defconfig
```kconfig
BR2_riscv=y
BR2_RISCV_64=y
BR2_RISCV_ISA_RVC=y
BR2_RISCV_ISA_RVV=y
BR2_RISCV_ABI_LP64D=y
BR2_LINUX_KERNEL=y
BR2_LINUX_KERNEL_CUSTOM_VERSION=y
BR2_LINUX_KERNEL_CUSTOM_VERSION_VALUE="6.6.44"
BR2_LINUX_KERNEL_USE_ARCH_DEFAULT_CONFIG=y
BR2_LINUX_KERNEL_CONFIG_FRAGMENT_FILES="$(TOPDIR)/../../guest/linux.fragment"
BR2_TARGET_OPENSBI=y
BR2_TARGET_OPENSBI_PLAT="generic"
BR2_TARGET_OPENSBI_ADDITIONAL_VARIABLES="PLATFORM_RISCV_ISA=rv64imafdcv_zifencei"
BR2_TARGET_ROOTFS_EXT2=y
BR2_TARGET_ROOTFS_EXT2_SIZE="256M"
BR2_PACKAGE_HOST_LINUX_HEADERS_CUSTOM_6_6=y
BR2_ROOTFS_POST_BUILD_SCRIPT="$(TOPDIR)/../../guest/post_build.sh"
BR2_GLOBAL_PATCH_DIR="$(TOPDIR)/../../guest/buildroot-patches"
BR2_PACKAGE_COREMARK=y
BR2_PACKAGE_COREMARK_PRO=y
BR2_PACKAGE_DHRYSTONE=y
BR2_PACKAGE_WHETSTONE=y
BR2_PACKAGE_LMBENCH=y
BR2_PACKAGE_MBW=y
BR2_PACKAGE_RAMSPEED=y
BR2_PACKAGE_STRESS_NG=y
BR2_PACKAGE_LINUX_TOOLS_PERF=y
```
